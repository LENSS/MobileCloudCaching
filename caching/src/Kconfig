## caching/src/Kconfig
```kconfig
#
# Caching Daemon configuration
#

config caching
	tristate "A Caching Daemon"
	default n
	help
	  This is a kernel moduler, for supporting distributed caching for k-out-of-n computing.
	  If unsure, say N.
```

## kaodv/src/Kconfig
```kconfig
#
# AODV configuration
#

config KAODV
	tristate "Kernel AODV"
	default n
	help
	  This is a kernel moduler, for supporting AODV routing protocol.
	  If unsure, say N.
```

## simpleFS/src/KConfig
```kconfig
#
# SimpleFS configuration
#

config simpleFS
	tristate "A Simple File System"
	default n
	help
	  This is a simple file system, for supporting file creation and retrieving for k-out-of-n computing.
	  If unsure, say N.
```
